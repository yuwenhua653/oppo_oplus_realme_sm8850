// SPDX-License-Identifier: BSD-3-Clause
/* Copyright (c) Qualcomm Technologies, Inc. and/or its subsidiaries. */

/dts-v1/;
/plugin/;

#include "myron-audio-mtp.dtsi"

/ {
	model = "Qualcomm Technologies, Inc. Myron based on SM8850";
	compatible = "qcom,canoe-mtp", "qcom,canoe", "qcom,mtp";
	qcom,msm-id = <660 0x10000>, <660 0x20000>, <661 0x10000>, <661 0x20000>,
		      <0x1000294 0x10000>, <0x1000294 0x20000>,
		      <0x1000295 0x10000>, <0x1000295 0x20000>,
		      <722 0x30000>, <723 0x30000>,
		      <743 0x10000>, <743 0x20000>;
	qcom,board-id = <8 0>;
	xiaomi,miboard-id = <0x4 0>;
};
