// SPDX-License-Identifier: BSD-3-Clause
/*
 * Copyright (c) Qualcomm Technologies, Inc. and/or its subsidiaries.
 */

/dts-v1/;
/plugin/;

#include "shikra-evk.dtsi"

/ {
  model = "Qualcomm Technologies, Inc. Shikra IQS";
  compatible = "qcom,shikra-iqs", "qcom,shikra";
  qcom,board-id = <0x20033 0x0>;
};
