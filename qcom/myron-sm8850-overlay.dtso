/dts-v1/;
/plugin/;

#include "myron-sm8850.dtsi"
#include "myron-charger-common.dtsi"
#include "myron-nxp-nfc-common.dtsi"
#include "myron-sm8850-touch.dtsi"

/ {
	model = "Qualcomm Technologies, Inc. Myron based on SM8850";
	compatible = "qcom,canoe-mtp", "qcom,canoe", "qcom,canoep-mtp", "qcom,canoep",
			   "qcom,mtp";
	qcom,msm-id = <660 0x10000>, <660 0x20000>, <661 0x10000>, <661 0x20000>,
		      <0x1000294 0x10000>, <0x1000294 0x20000>,
		      <0x1000295 0x10000>, <0x1000295 0x20000>;
	qcom,board-id = <8 0>;
	xiaomi,miboard-id = <0x4 0>;
};