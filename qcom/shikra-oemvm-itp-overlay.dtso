// SPDX-License-Identifier: BSD-3-Clause
/*
 * Copyright (c) Qualcomm Technologies, Inc. and/or its subsidiaries.
 */
/dts-v1/;
/plugin/;

#include "shikra-oemvm-avf.dtsi"
#include "shikra-oemvm-itp-avf.dtsi"

/ {
	model = "Qualcomm Technologies, Inc. Shikra OEMVM ITP";
	compatible = "qcom,shikra-atp", "qcom,shikra", "qcom,shikrap-atp",
			"qcom,shikrap", "qcom,atp";
	qcom,board-id = <0 0>;

	host {
	};
};
