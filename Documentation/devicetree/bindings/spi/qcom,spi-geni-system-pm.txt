## Kconfig.qcom
```kconfig
# SPDX-License-Identifier: GPL-2.0

menu "Qualcomm SoC Repostiory Configuration"

source "arch/arm64/gunyah/Kconfig"

source "arch/arm64/Kconfig.platforms.qcom"

source "drivers/base/regmap/Kconfig.qcom"

source "drivers/bus/mhi/Kconfig.qcom"

source "drivers/char/Kconfig.qcom"

source "drivers/clk/qcom/Kconfig.qcom"

source "drivers/cpufreq/Kconfig.arm.qcom"

source "drivers/cpuidle/Kconfig.qcom"

source "drivers/devfreq/Kconfig.qcom"

source "drivers/dma-buf/heaps/Kconfig.qcom"

source "drivers/dma/qcom/Kconfig.qcom"

source "drivers/edac/Kconfig.qcom"

source "drivers/extcon/Kconfig.qcom"

source "drivers/firmware/Kconfig.qcom"

source "drivers/gpu/drm/bridge/Kconfig.qcom"

source "drivers/gpu/drm/msm/Kconfig.qcom"

source "drivers/hwmon/Kconfig.qcom"

source "drivers/hwtracing/coresight/Kconfig.qcom"

source "drivers/hwtracing/stm/Kconfig.qcom"

source "drivers/i2c/busses/Kconfig.qcom"

source "drivers/i3c/master/Kconfig.qcom"

source "drivers/iio/adc/Kconfig.qcom"

source "drivers/iio/dac/Kconfig.qcom"

source "drivers/input/misc/Kconfig.qcom"

source "drivers/input/touchscreen/Kconfig.qcom"

source "drivers/interconnect/Kconfig.qcom"

source "drivers/iommu/Kconfig.qcom"

source "drivers/irqchip/Kconfig.qcom"

source "drivers/leds/Kconfig.qcom"

source "drivers/mailbox/Kconfig.qcom"

source "drivers/mfd/Kconfig.qcom"

source "drivers/eom/Kconfig"

source "drivers/eom/pcie/Kconfig"

source "drivers/misc/Kconfig.qcom"

source "drivers/mmc/host/Kconfig.qcom"

source "drivers/net/Kconfig.qcom"

source "drivers/nvmem/layouts/Kconfig.qcom"

source "drivers/pci/controller/Kconfig.qcom"

source "drivers/perf/Kconfig.qcom"

source "drivers/phy/Kconfig.qcom"

source "drivers/phy/qualcomm/Kconfig.qcom"

source "drivers/pinctrl/qcom/Kconfig.qcom"

source "drivers/power/reset/Kconfig.qcom"

source "drivers/power/supply/Kconfig.qcom"

source "drivers/powercap/qcom/Kconfig"

source "drivers/ptp/Kconfig.qcom"

source "drivers/pwm/Kconfig.qcom"

source "drivers/regulator/Kconfig.qcom"

source "drivers/remoteproc/Kconfig.qcom"

source "drivers/rpmsg/Kconfig.qcom"

source "drivers/soc/qcom/dcvs/Kconfig"

source "drivers/soc/qcom/Kconfig.qcom"

source "drivers/soc/qcom/mem_buf/Kconfig"

source "drivers/soc/qcom/memshare/Kconfig"

source "drivers/spi/Kconfig.qcom"

source "drivers/spmi/Kconfig.qcom"

source "drivers/thermal/qcom/Kconfig.qcom"

source "drivers/tty/hvc/Kconfig.qcom"

source "drivers/tty/serial/Kconfig.qcom"

source "drivers/ufs/host/Kconfig.qcom"

source "drivers/uio/Kconfig.qcom"

source "drivers/usb/dwc3/Kconfig.qcom"

source "drivers/usb/gadget/Kconfig.qcom"

source "drivers/usb/Kconfig.qcom"

source "drivers/rtc/Kconfig.qcom"

source "drivers/video/Kconfig.qcom"

source "drivers/virt/Kconfig.qcom"

source "drivers/virtio/Kconfig.qcom"

source "init/Kconfig.qcom"

source "kernel/sched/walt/Kconfig"

source "kernel/trace/Kconfig.qcom"

source "net/Kconfig.qcom"

source "sound/usb/Kconfig.qcom"

source "drivers/block/Kconfig.qcom"

source "Kconfig.qtvm"

source "drivers/block/zram/Kconfig.qcom"

endmenu

source "drivers/xiaomi/myron/Kconfig"
```

## drivers/bus/mhi/Kconfig.qcom
```kconfig
# SPDX-License-Identifier: GPL-2.0
#
# MHI bus
#
# Copyright (c) 2021, Linaro Ltd.
#

source "drivers/bus/mhi/host/Kconfig.qcom"
source "drivers/bus/mhi/devices/Kconfig"
```

## drivers/input/touchscreen/xiaomi/Kconfig
```kconfig
# SPDX-License-Identifier: GPL-2.0-only
config TOUCHSCREEN_XIAOMI_TOUCHFEATURE
	tristate "Xiaomi touch framework (Myron source candidate)"
	depends on INPUT_TOUCHSCREEN && DRM && QCOM_PANEL_EVENT_NOTIFIER
	depends on MIEV && POWER_SUPPLY && NET && PROC_FS && SYSFS
	help
	  Xiaomi framework and touchfeature userspace interfaces. This does not
	  provide the Myron FocalTech FT3683 controller driver.
```

## drivers/interconnect/Kconfig.qcom
```kconfig
# SPDX-License-Identifier: GPL-2.0-only
if INTERCONNECT

source "drivers/interconnect/qcom/Kconfig.qcom"

endif
```

## drivers/misc/hwid/Kconfig
```kconfig
config MI_HARDWARE_ID
	tristate "Xiaomi hardware identification"
	depends on QCOM_SOCINFO
	help
	  Xiaomi hardware identification from bootloader module parameters.
```

## drivers/misc/miev/Kconfig
```kconfig
config MIEV
	tristate "Xiaomi misight event (miev) log channel"
	help
	  Xiaomi MiSight event log char device. Provides the cdev_tevent_*
	  kernel API used by charge/haptic/usb drivers to report fault and
	  telemetry events to the misight userspace daemon via /dev/miev.
```

## drivers/net/phy/Kconfig.qcom
```kconfig
# SPDX-License-Identifier: GPL-2.0-only
#
# PHY Layer Configuration
#

source "drivers/net/phy/aquantia/Kconfig.qcom"

config DP83867_PHY
	tristate "Texas Instruments DP83867 Gigabit PHY"
	help
	  Currently supports the DP83867 PHY.
```

## drivers/usb/Kconfig.qcom
```kconfig
# SPDX-License-Identifier: GPL-2.0
#
# USB device configuration
#

if USB_SUPPORT

source "drivers/usb/dwc3/Kconfig.qcom"

comment "USB port drivers"

source "drivers/usb/pd/Kconfig"

source "drivers/usb/phy/Kconfig.qcom"

source "drivers/usb/gadget/Kconfig.qcom"

source "drivers/usb/typec/Kconfig.qcom"

source "drivers/usb/repeater/Kconfig"

source "drivers/usb/redriver/Kconfig"

endif # USB_SUPPORT
```

## drivers/usb/typec/Kconfig.qcom
```kconfig
# SPDX-License-Identifier: GPL-2.0

if TYPEC

source "drivers/usb/typec/mux/Kconfig.qcom"

source "drivers/usb/typec/ucsi/Kconfig.qcom"

endif # TYPEC
```

## drivers/video/Kconfig.qcom
```kconfig
# SPDX-License-Identifier: GPL-2.0
#
# Video configuration
#

source "drivers/video/backlight/Kconfig.qcom"
```

## drivers/virt/Kconfig.qcom
```kconfig
# SPDX-License-Identifier: GPL-2.0-only
#
# Virtualization support drivers
#

if VIRT_DRIVERS

source "drivers/virt/gunyah/Kconfig.qcom"

endif
```

## r58-driver/Kconfig
```kconfig
# SPDX-License-Identifier: GPL-2.0-only
config TOUCHSCREEN_FOCALTECH_MYRON
	tristate "Myron FT3683 SPI touchscreen (TIC test driver)"
	depends on ARM64 && SPI && INPUT && OF && GPIOLIB && REGULATOR && PINCTRL
	help
	  Direct protocol-v2 multitouch for the stock Myron device tree.
	  Does not implement Xiaomi THP, FOD, gestures, or firmware updates.
```

## r72-build-route/fragments/Kconfig
```kconfig
config MYRON_MCA_READONLY
    tristate "Myron independent read-only MCA telemetry (compile qualification only)"
    depends on OF && SYSFS && QTI_PMIC_GLINK
    default n
    help
      Compile an independent opt-in diagnostic client with a fixed read-only
      property allowlist. This does not enable charging policies, replace
      power_supply reporting or install any module on a device.
```

## r74-build-route/fragments/Kconfig
```kconfig
config MYRON_MCA_READONLY
    tristate "Myron independent read-only MCA telemetry (compile qualification only)"
    depends on OF && SYSFS && POWER_SUPPLY && QTI_PMIC_GLINK
    default n
    help
      Compile an independent opt-in GET-only client with a fixed property
      allowlist and optional read-only USB power_supply reporting. This
      does not enable charging policies or install any module on a device.
```

## r77-build-route/fragments/Kconfig
```kconfig
config MYRON_BUCK_THERMAL
    tristate "Myron independent buck thermal observer (compile qualification only)"
    depends on OF && SYSFS
    default n
    help
      Compile a default-off observer of board thermal-limit input. The module
      reports received limits without MCA, GLINK, voting or charger writes.
      Compilation does not install, load or enable the observer on a device.
```

## r78-build-route/audio/payload/drivers/xiaomi/myron_tfa98xx/Kconfig
```kconfig
# SPDX-License-Identifier: GPL-2.0-only
config MYRON_TFA98XX
	tristate "Myron TFA98xx source port (experimental)"
	depends on I2C && SND_SOC && OF && GPIOLIB
	select REGMAP_I2C
	default n
	help
	  Review-only port of MiCode onyx-v-oss v6.13. Hardware firmware,
	  revision and ASoC machine contracts must be confirmed before use.
```

## r78-build-route/audio/preimage/drivers/xiaomi/myron/Kconfig
```kconfig
# SPDX-License-Identifier: GPL-2.0-only
# Isolated myron experiment; each option defaults off for other targets.
menu "Myron experimental Xiaomi modules"
config FINGERPRINT_MI_FP
    tristate "Xiaomi mi_fp fingerprint driver"
    depends on ARM64 && OF && INPUT && GPIOLIB && REGULATOR
    depends on QCOM_PANEL_EVENT_NOTIFIER
    default n

config FP_HAVE_MULTI_SCREEN
    bool "Fingerprint multi-screen notifications"
    depends on FINGERPRINT_MI_FP
    default n

config SIDE_FINGERPRINT
    bool "Side fingerprint variant"
    depends on FINGERPRINT_MI_FP
    default n

config FOD_FINGERPRINT
    bool "Optical FOD fingerprint variant"
    depends on FINGERPRINT_MI_FP
    default n
    help
      Keep disabled for the tested myron FP_ULTRA_QCOM source path.

config MI_STACK
    tristate "Xiaomi task stack inspection"
    depends on ARM64 && PROC_FS && STACKTRACE
    default n

config MI_UBT
    tristate "Xiaomi user backtrace helper"
    depends on ARM64 && MMU
    default n

config PRINTK_ENHANCE
    tristate "Xiaomi printk annotation"
    depends on PROC_FS && ANDROID_VENDOR_HOOKS
    default n
source "$(KCONFIG_EXT_PREFIX)drivers/misc/hwid/Kconfig"
source "$(KCONFIG_EXT_PREFIX)drivers/misc/miev/Kconfig"
source "$(KCONFIG_EXT_PREFIX)drivers/input/touchscreen/xiaomi/Kconfig"
config MYRON_MCA_BASE
    tristate "Myron MCA base layer source candidates"
    depends on SYSFS && OF && MI_HARDWARE_ID
    default n
    help
      Seven MCA infrastructure modules. Charger ICs, ADSP protocols
      and current/voltage/thermal policy drivers are not included.
config MYRON_MCA_INTERFACE
    tristate "Myron MCA charge interface source candidate"
    depends on SYSFS && OF && MYRON_MCA_BASE
    default n
    help
      Source build candidate only. Hardware backends and charging
      policies require further integration and runtime validation.
config MYRON_MCA_PLATFORM
    tristate "Myron MCA platform and protocol interface source candidates"
    depends on MYRON_MCA_BASE && SYSFS && OF && TREE_SRCU
    default n
    help
      Source build candidate only. Hardware backends and charging
      policies require further integration and runtime validation.
config MYRON_MISC
	tristate "Myron infrared and ST54SE GPIO drivers"
	depends on OF && GPIOLIB && SPI
    default n
config MYRON_MCA_SERVICES
    tristate "Myron MCA service source candidates"
    depends on MYRON_MCA_PLATFORM && MYRON_MCA_INTERFACE
    depends on OF && SYSFS && I2C && POWER_SUPPLY && THERMAL
    depends on QTI_PMIC_GLINK && DRM_PANEL
    default n
    help
      Same-source build candidates only. GLINK owner conflicts, charging
      policy coverage, DT resources and removal safety remain deployment gates.
      No charger_partition source or private SCSI header is included.

config MYRON_CHARGE_IC
    tristate "Myron charge IC source candidates"
    depends on I2C && OF && GPIOLIB && REGMAP_I2C
    depends on MYRON_MCA_BASE && MYRON_MCA_PLATFORM
    default n
    help
      Compile-only candidates from pinned Xiaomi Onyx sources. This does
      not certify Myron FOD data, voltage thresholds or charging behavior.

config MYRON_IC_FIRMWARE_PROGRAMMING
    bool
    default n
    help
      Deliberately hidden and disabled: Onyx embedded firmware and battery
      nonvolatile calibration updates have not been qualified for Myron.

endmenu

config MYRON_MCA_COMPLETE_SERVICES
    tristate "Myron complete MCA services (compile qualification only)"
    depends on MYRON_MCA_SERVICES && SCSI && BLK_DEV_SD
    default n
    help
      Build the complete vendor MCA strategy and charging services for
      compile/modpost qualification. This does not select them for installation
      or authorize runtime charging/storage behavior. Keep IC firmware
      programming disabled; persistent writes are guarded off by default.
config MYRON_BQ_READONLY
    tristate "Myron independent read-only fuel gauge (compile qualification only)"
    depends on I2C && OF && POWER_SUPPLY
    default n
    help
      Build an independent read-only I2C fuel-gauge candidate using Linux
      power_supply interfaces. This option only permits compilation; the
      module also requires an explicit enable_readonly opt-in at load time.
      No charging policy, firmware update or device deployment is selected.

config MYRON_MCA_READONLY
    tristate "Myron independent read-only MCA telemetry (compile qualification only)"
    depends on OF && SYSFS && POWER_SUPPLY && QTI_PMIC_GLINK
    default n
    help
      Compile an independent opt-in GET-only client with a fixed property
      allowlist and optional read-only USB power_supply reporting. This
      does not enable charging policies or install any module on a device.

config MYRON_BUCK_THERMAL
    tristate "Myron independent buck thermal observer (compile qualification only)"
    depends on OF && SYSFS
    default n
    help
      Compile a default-off observer of board thermal-limit input. The module
      reports received limits without MCA, GLINK, voting or charger writes.
      Compilation does not install, load or enable the observer on a device.
```
